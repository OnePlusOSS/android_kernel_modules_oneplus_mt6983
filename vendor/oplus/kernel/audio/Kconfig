## vendor/oplus/kernel/audio/Kconfig
```kconfig
#
# oplus extend audio codec configuration
#
config SND_SOC_SIA81XX
	tristate "SoC Audio for  SIA81XX PA"
	default n
	help
	  This option enables support for SIA81XX  K PA.

config SND_SOC_OPLUS_PA_MANAGER
	tristate "SoC Audio for PA MANAGER"
	default n
	help
	  This option enables support for PA MANAGER.

config SIA_PA_ALGO
	tristate "Use SIA PA ALGO"
	default n

config HSKEY_BLOCK
	tristate "Block hskey for 1s"
	default n

config OPLUS_MTK_AUDIO_EXT
	tristate "Support oplus audio drv ext"
	default n
	help
	  This adds sipa driver for Mediatek boards
	  that can be used with other platforms
	  Select m if you have such device.
	  If unsure select "N".

config SND_SOC_TFA9873
	tristate "NXP TFA9873 speaker amplifier"
	depends on I2C
	help
	  Config of TFA9873. It is a Smart power
	  amplifier which contain speaker protection,
	  multi-band DRC, equalizer function. It would
	  be set to yes if device with TFA9873 on it.

config SND_SOC_TFA9874
	tristate "NXP TFA9874 speaker amplifier"
	depends on I2C
	help
	  Config of TFA9874. It is a Smart power
	  amplifier which contain speaker protection,
	  multi-band DRC, equalizer function. It would
	  be set to yes if device with TFA9874 on it.

config SND_SOC_AW87XXX_2_X_0
        tristate "SoC Audio for awinic AW87XXX Smart K PA"
        depends on I2C
        help
          This option enables support for AW87XXX Smart K PA.

config OPLUS_MT6835_USE_FSA4480
	tristate "No Support mt6338_accdet_irq_check_and_set"
	default n
	help
	  This adds for fsa4480/dio4480 audio switch driver
	  that can be used with other platforms
	  Select m if you have such device.
	  If unsure select "N"

config SND_SOC_AW882XX
	tristate "Support AW882XX speaker amplifier"
	depends on I2C
	help
	  Config of AW882XX. It is a Smart power
	  amplifier which contain speaker protection,
	  multi-band DRC, equalizer function. It would
	  be set to yes if device with AW882XX on it.

config SND_SOC_OPLUS_TYPEC_SWITCH
	tristate "TypeC Switch for DIO 448x or WAS 7483"
	depends on I2C
	help
	  Config of 4480 or 4483. It is a USB type-C Analog Audio
	  Switch.

config OPLUS_MTK_HEADSET_RECHECK
	tristate "recheck headset plug in/out after accdet gpio irq 1s"
	depends on SND_SOC_MT6989_MT6681
	default n
	help
	  This adds for Mediatek boards
	  that can be used with other platforms
	  Select m if you have such device.
	  If unsure select "N".

config OPLUS_MTK_ACCDET_CHECK_RESET
	tristate "check and reset accdet reg when plug in"
	# depends on SND_SOC_MT6989_MT6681
	default n
	help
	  This adds for Mediatek boards
	  that can be used with other platforms
	  Select m if you have such device.
	  If unsure select "N".

# add for SIA SmartPA sia91xxseries
config SND_SOC_SIA91XX_V3_1_0
	tristate "SIA91XX speaker amplifier"
	depends on I2C
	help
	  Config of SIA98xxx. It is a Smart power
	  amplifier which contain speaker protection,
	  multi-band DRC, equalizer function. It would
	  be set to yes if device with SIA91xxx on it.
```

## vendor/oplus/kernel/cpu/waker_identify/Kconfig
```kconfig
# SPDX-License-Identifier: GPL-2.0-only
# Copyright (C) 2023-2030 Oplus. All rights reserved.

config OPLUS_FEATURE_WAKER_IDENTIFY
    tristate "oplus waker identify"
    default n
    help
      oplus waker identify
```

## vendor/oplus/kernel/device_info/pogo_keyboard/Kconfig
```kconfig
#
# The pogo keyboard drivers.
#
config POGO_KEYBOARD
	tristate "Pogo Keypad Support"
	help
	  Say Y here if you want to use the keypad.
	  If unuse, say N.
	  To compile this driver as a module, choose M here: the
	  module will be called.
```

## vendor/oplus/kernel/storage/storage_feature_in_module/common/file_record/Kconfig
```kconfig
config OPLUS_FEATURE_FILE_RECORD
    tristate "record IO file path"
    default n
    help
      define this config to record IO file path.
```

## vendor/oplus/kernel/storage/storage_feature_in_module/common/iolimit/Kconfig
```kconfig
config UNISOC_IOLIMIT
    tristate "vfs io limit support"
    depends on BLK_CGROUP
    help
      Provide a blkio policy implementing for io bandwidth while a process
      in the cgroup buffer write.
```

## vendor/oplus/kernel/touchpanel/oplus_touchscreen/Focal/ft8057p/Kconfig
```kconfig
config TOUCHPANEL_FOCAL_FT8057P
	bool "TP Focal_FT8057P IC enable or not for OPLUS"
	---help---
	say Y to enable driver for Touchpanel using Focal FT8057P
```

## vendor/oplus/kernel/tp/hbp/hbp/Kconfig
```kconfig
config TOUCHSCREEN_HBP_CORE
    tristate "Oplus Touchscreen"
    default n
    help
      Say Y here if you have Focaltech touch panel.
      If unsure, say N.

source "drivers/input/touchscreen/tp_hbp/chips/focal/ft3683g/Kconfig"
```

## vendor/oplus/kernel_5.10/audio/Kconfig
```kconfig
#
# oplus extend audio codec configuration
#
config SND_SOC_SIA81XX
	tristate "SoC Audio for  SIA81XX PA"
	help
	This option enables support for SIA81XX  K PA.

config SND_SOC_OPLUS_PA_MANAGER
	tristate "SoC Audio for PA MANAGER"
	help
	This option enables support for PA MANAGER.

config SIA_PA_ALGO
	bool "Use SIA PA ALGO"
	default n

config OPLUS_MTK_PLATFORM
	bool "Use MTK PLATFORM"
	default n

config HSKEY_BLOCK
	bool "Block hskey for 1s"
	default n

config SND_SOC_OPLUS_TYPEC_SWITCH
	tristate "TypeC Switch for DIO 448x or WAS 7483"
	depends on I2C
	help
	  Config of 4480 or 4483. It is a USB type-C Analog Audio
	  Switch.

config SND_SMARTPA_AW883XX
	tristate "SoC Audio for awinic aw883xx series"
	depends on I2C
	help
	  This option enables support for aw883xx series Smart PA.

config SND_SOC_CODEC_AW882XX
	tristate "SoC Audio for awinic aw882xx series"
	depends on I2C
	help
	  This option enables support for aw882xx series Smart PA.
```

## vendor/oplus/sensor/kernel/oplus_consumer_ir/Kconfig
```kconfig
config OPLUS_SENSOR_CONSUMER_IR_CORE
	tristate "sensor consumer ir config for core"
	help
	  To compile this driver as a module, set m in kernel build config
	  module will be called oplus_ir_core.
config OPLUS_SENSOR_CONSUMER_IR_QC
	tristate "sensor consumer ir config for qcom"
	help
	  To compile this driver as a module, set m in kernel build config
	  module will be called oplus_ir_spi.
config OPLUS_SENSOR_CONSUMER_IR_MTK
	tristate "sensor consumer ir config for MediaTek"
	help
	  To compile this driver as a module, set m in kernel build config
	  module will be called oplus_ir_pwm.
config OPLUS_SENSOR_IR_USE_WL2866D
	bool "use ldo WL2866"
	help
	  To use ldo WL2866, added flag for new kernels as previous flag not available.
```

## vendor/oplus/sensor/kernel/oplus_virtual_sensor/sensors/ambiente_proxhub/Kconfig
```kconfig
config OPLUS_FEATURE_AMBIENTE_PROX
	bool "ambiente_proxhub for MediaTek package"
	default n
```

## vendor/oplus/sensor/kernel/oplus_virtual_sensor/sensors/gesture_proxhub/Kconfig
```kconfig
config OPLUS_FEATURE_GESTURE_PROX
	bool "gesture_proxhub for MediaTek package"
	default n
```

## vendor/oplus/sensor/kernel/oplus_virtual_sensor/sensors/phone_proxhub/Kconfig
```kconfig
config OPLUS_FEATURE_PHONE_PROX
	bool "phone_proxhub for MediaTek package"
	default n
```
